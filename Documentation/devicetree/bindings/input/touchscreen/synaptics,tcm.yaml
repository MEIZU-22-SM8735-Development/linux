## Documentation/devicetree/bindings/input/touchscreen/synaptics,tcm.yaml
```yaml
# SPDX-License-Identifier: (GPL-2.0-only OR BSD-2-Clause)
%YAML 1.2
---
$id: http://devicetree.org/schemas/input/touchscreen/synaptics,tcm.yaml#
$schema: http://devicetree.org/meta-schemas/core.yaml#

title: Synaptics TouchComm (TCM) SPI touchscreen controller

maintainers:
  - Linux Meizu 22 project <98950213+14185638@users.noreply.github.com>

description: |
  Synaptics TouchComm (TCM) controllers speak a packetised command/report
  protocol over SPI.  A report is requested by the host with a GET_REPORT
  command and the controller signals its availability with a level low
  interrupt line; reset is a GPIO that is asserted low.

  The controller is powered from two rails, a digital one (vdd, 1.8 V) and an
  analogue one (avdd, 2.7 V to 3.55 V).

allOf:
  - $ref: touchscreen.yaml#
  - $ref: /schemas/input/input.yaml#
  - $ref: /schemas/spi/spi-peripheral-props.yaml#

properties:
  compatible:
    const: synaptics,tcm-spi

  reg:
    maxItems: 1

  interrupts:
    maxItems: 1
    description: Level low interrupt used by the controller to request service

  reset-gpios:
    maxItems: 1
    description: Active low reset line

  vdd-supply:
    description: Digital (I/O) supply, 1.71 V to 1.95 V

  avdd-supply:
    description: Analogue supply, 2.7 V to 3.544 V

  firmware-name:
    maxItems: 1
    description: |
      Basename of the TouchComm firmware image.  Defaults to
      "synaptics/firmware.img" when absent.

required:
  - compatible
  - reg
  - interrupts
  - vdd-supply
  - avdd-supply

unevaluatedProperties: false

examples:
  - |
    #include <dt-bindings/gpio/gpio.h>
    #include <dt-bindings/interrupt-controller/irq.h>

    spi {
        #address-cells = <1>;
        #size-cells = <0>;

        touchscreen@0 {
            compatible = "synaptics,tcm-spi";
            reg = <0>;
            spi-max-frequency = <15000000>;
            interrupt-parent = <&tlmm>;
            interrupts = <176 IRQ_TYPE_LEVEL_LOW>;
            reset-gpios = <&tlmm 189 GPIO_ACTIVE_LOW>;
            vdd-supply = <&vreg_ldod1>;
            avdd-supply = <&vreg_ldob22>;
            firmware-name = "synaptics/firmware.img";
            touchscreen-size-x = <1220>;
            touchscreen-size-y = <2712>;
        };
    };

...
```

## Documentation/devicetree/bindings/power/reset/qcom,pshold.yaml
```yaml
# SPDX-License-Identifier: GPL-2.0-only OR BSD-2-Clause
%YAML 1.2
---
$id: http://devicetree.org/schemas/power/reset/qcom,pshold.yaml#
$schema: http://devicetree.org/meta-schemas/core.yaml#

title: Qualcomm SoC restart and power off

maintainers:
  - Bjorn Andersson <bjorn.andersson@linaro.org>

description:
  A power supply hold (ps-hold) bit is set to power the Qualcomm chipsets.
  Clearing that bit allows us to restart/power off. The difference between
  power off and restart is determined by unique power manager IC settings.

properties:
  compatible:
    const: qcom,pshold

  reg:
    maxItems: 1

  qcom,pon:
    $ref: /schemas/types.yaml#/definitions/phandle
    description:
      Phandle to the PMIC PON node that owns the PBS.  Where the PS_HOLD
      sequencing lives in that block (PMK8550 and its relatives), the reset
      type has to be programmed before PS_HOLD is released, or the PMIC treats
      the request as a shutdown.  With this present the driver programs a hard
      reset; without it, its historical behaviour (release PS_HOLD, board powers
      off) is unchanged.

required:
  - compatible
  - reg

additionalProperties: false

examples:
  - |
    reset-controller@fc4ab000 {
        compatible = "qcom,pshold";
        reg = <0xfc4ab000 0x4>;
    };
```

## Documentation/devicetree/bindings/soc/qcom/meizu,m2582-pdc-init.yaml
```yaml
# SPDX-License-Identifier: (GPL-2.0-only OR BSD-2-Clause)
%YAML 1.2
---
$id: http://devicetree.org/schemas/soc/qcom/meizu,m2582-pdc-init.yaml#
$schema: http://devicetree.org/meta-schemas/core.yaml#

title: Meizu 22 (M2582) WCN power domain controller init table

maintainers:
  - The Meizu 22 mainline port

description: |
  The WCN7750's power domain controller has to be programmed through the AOP
  before the chip's rails are enabled.  The vendor's Bluetooth power driver
  does it from its own device tree node: it reads qcom,pdc_init_table and
  sends every entry to the AOP over the QMP mailbox (btpower.ko,
  bt_aop_pdc_reconfig at .text+0x30ac).  Mainline has no counterpart, so the
  table is carried here.

  The node must be probed before the Bluetooth controller's, because the table
  has to be on the wire before that driver enables the rails.  That ordering is
  expressed by the Bluetooth node referring to this one through power-domains,
  which makes the Bluetooth device defer until this driver has probed.

  The entries are the vendor's own strings, verbatim, so that the table stays
  traceable to the factory device tree; the driver parses them and rebuilds the
  wire form the vendor sends ("{class: wlan_pdc, res: %s.%s, %s: %d}").

properties:
  compatible:
    const: meizu,m2582-pdc-init

  qcom,qmp:
    $ref: /schemas/types.yaml#/definitions/phandle
    description:
      The AOP QMP mailbox.  The driver defers until this provider has probed.

  qcom,pdc-init-table:
    $ref: /schemas/types.yaml#/definitions/string-array
    description:
      The PDC init table, one entry per message, in the vendor's declarative
      form: "{class: <class>, ss: <subsystem>, res: <resource>, <key>: <value>}".
      The "ss" field is validated and not sent; the message put on the wire
      carries class, res and the single value field.

  "#power-domain-cells":
    const: 0

  m2582,feature:
    $ref: /schemas/types.yaml#/definitions/string
    description:
      The project's subsystem gate: the node is disabled unless this name is in
      the m2582.features= command line list.

required:
  - compatible
  - qcom,qmp
  - qcom,pdc-init-table
  - "#power-domain-cells"

additionalProperties: false

examples:
  - |
    pdc-init {
        compatible = "meizu,m2582-pdc-init";
        m2582,feature = "bt";

        qcom,qmp = <&aoss_qmp>;

        qcom,pdc-init-table =
            " {class: wlan_pdc, ss: rf, res: s3b.v, upval: 976}",
            " {class: wlan_pdc, ss: bb, res: pdc, enable: 1}";

        #power-domain-cells = <0>;
    };
```

## Documentation/devicetree/bindings/thermal/qcom,cpu-hotplug.yaml
```yaml
# SPDX-License-Identifier: (GPL-2.0-only OR BSD-2-Clause)
%YAML 1.2
---
$id: http://devicetree.org/schemas/thermal/qcom,cpu-hotplug.yaml#
$schema: http://devicetree.org/meta-schemas/core.yaml#

title: Qualcomm CPU hotplug thermal cooling device

description: |
  A cooling device per CPU whose entire job is to take that CPU out of
  service when a thermal zone asks for it.  State 0 leaves the CPU online,
  state 1 offlines it.

  Qualcomm's own emergency ladder uses this as the hardest step: a CPU sensor
  at 120 C offlines the core it watches.  The step below it in their design,
  cpu-pause, only hides the CPU from the WALT scheduler and has nothing to
  drive it in mainline.

  CPU0 is not usable because the kernel does not allow offlining it.

properties:
  compatible:
    const: qcom,cpu-hotplug

patternProperties:
  "^cpu[0-9]+-hotplug$":
    type: object
    additionalProperties: false

    properties:
      qcom,cpu:
        $ref: /schemas/types.yaml#/definitions/phandle
        description: CPU node this cooling device offlines

      qcom,cdev-alias:
        $ref: /schemas/types.yaml#/definitions/string
        description: |
          Name the cooling device appears under in
          /sys/class/thermal.  Defaults to "cpuN-hotplug".

      "#cooling-cells":
        const: 2

    required:
      - qcom,cpu
      - "#cooling-cells"

required:
  - compatible

additionalProperties: false

examples:
  - |
    #include <dt-bindings/thermal/thermal.h>

    cpu-hotplug {
        compatible = "qcom,cpu-hotplug";

        cpu7-hotplug {
            qcom,cpu = <&cpu7>;
            #cooling-cells = <2>;
        };
    };
...
```
